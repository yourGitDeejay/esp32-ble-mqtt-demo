## components/shared-manager/Kconfig.projbuild
```kconfig
menu "Shared Manager Configuration"

    config SHOW_DEBUG_MESSAGES
        bool "Print debug messages"
        default y
        help
            Print debug messages to console.

endmenu
```

## main/Kconfig.projbuild
```kconfig
menu "Main Configuration"

    config WIFI_SSID
        string "SSID of WiFi"
        default ""
        help
            Print debug messages to console.

    config WIFI_PASSWORD
        string "Password of WiFi"
        default ""
        help
            Print debug messages to console.

    config MQTT_SERVER_URI
        string "Broker URL"
        default ""
        help
            Print debug messages to console.

    config MQTT_SERVER_USERNAME
        string "Client credentials - username"
        default ""
        help
            Print debug messages to console.

    config MQTT_SERVER_PASSWORD
        string "Client credentials - password"
        default ""
        help
            Print debug messages to console.

    config MQTT_TEST_TOPIC
        string "Topic for testing"
        default ""
        help
            Print debug messages to console.

endmenu
```
